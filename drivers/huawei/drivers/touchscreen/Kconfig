## drivers/huawei/drivers/touchscreen/Kconfig
```kconfig
#menu "Rmi device drivers"
#source "drivers/huawei/drivers/touchscreen/rmi/Kconfig"
#endmenu

#@menu "Cypress device drivers"
#source "drivers/huawei/drivers/touchscreen/cypress/Kconfig"
#endmenu

menu "Cypress device drivers"
source "drivers/huawei/drivers/touchscreen/ts/Kconfig"
endmenu

menu "Cypress and rmi device h30l drivers"
source "drivers/huawei/drivers/touchscreen/ts_h30l/Kconfig"
endmenu

config  HUAWEI_H30L_TOUCH_CODE
	bool "touchscreen h30l driver"
	default n
	
```

## drivers/misc/hisi_6401_spk/Kconfig
```kconfig
config HISI_6401_SPK
	tristate "Spk support for HI6401"
	default n
	---help---
	 Say Y here if you want to support HI6401's speaker
```
